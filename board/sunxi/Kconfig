## board/sunxi/Kconfig
```kconfig
config SYS_CONFIG_NAME
	string
	default "sun4i" if TARGET_SUN4I
	default "sun5i" if TARGET_SUN5I
	default "sun7i" if TARGET_SUN7I

config SYS_CPU
	string
	default "armv7"

config SYS_BOARD
	string
	default "sunxi"

config SYS_SOC
	string
	default "sunxi"

config FTDFILE
	string "Default ftdfile env setting for this board"
```
